// * SPDX-License-Identifier: Apache-2.0
/* Copyright (c) 2025 Socionext Inc. */

/dts-v1/;

#include <socionext/uniphier-ld20.dtsi>

/ {
	model = "Socionext Akebi96 board";
	compatible = "socionext,uniphier-ld20-akebi96", "socionext,uniphier-ld20";

	chosen {
		zephyr,sram = &dram0;
		zephyr,console = &serial0;
		zephyr,shell-uart = &serial0;
	};

	dram0: memory@80000000 {
		compatible = "mmio-sram";
		device_type = "memory";
		reg = <0x80000000 DT_SIZE_M(128)>;
	};
};

&serial0 {
	status = "okay";
	current-speed = <115200>;
};

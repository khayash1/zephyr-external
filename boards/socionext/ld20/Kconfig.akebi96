## boards/socionext/ld20/Kconfig.akebi96
```kconfig
# SPDX-License-Identifier: Apache-2.0
# Copyright (c) 2025 Socionext Inc.

config BOARD_AKEBI96
	select SOC_UNIPHIER_LD20
```

## boards/socionext/ld20/board.yml
```yaml
board:
  name: akebi96
  full_name: Socionext Akebi96 board
  vendor: socionext
  socs:
  - name: ld20
```

## boards/socionext/nx1/Kconfig.nx1_ref
```kconfig
# SPDX-License-Identifier: Apache-2.0
# Copyright (c) 2025 Socionext Inc.

config BOARD_NX1_REF
	select SOC_UNIPHIER_NX1
```

## boards/socionext/nx1/board.yml
```yaml
board:
  name: nx1_ref
  full_name: Socionext NX1 reference board
  vendor: socionext
  socs:
  - name: nx1
```

## boards/socionext/nx1/nx1_ref_defconfig
```kconfig
# SPDX-License-Identifier: Apache-2.0

# CPU
CONFIG_ARMV8_A_NS=y
CONFIG_CACHE_MANAGEMENT=y
CONFIG_SMP=y
CONFIG_MP_MAX_NUM_CPUS=4
CONFIG_PM_CPU_OPS=y
CONFIG_TIMEOUT_64BIT=y

# Generic Kernel Options
CONFIG_XIP=n

# Serial Drivers
CONFIG_SERIAL=y
CONFIG_UART_INTERRUPT_DRIVEN=y

# Console Driver
CONFIG_CONSOLE=y
CONFIG_UART_CONSOLE=y

# Timer Drivers
CONFIG_TIMER_READS_ITS_FREQUENCY_AT_RUNTIME=y

# Misc.
CONFIG_BOOT_CLEAR_SCREEN=y
CONFIG_SHELL=y
CONFIG_PSCI_SHELL=y
CONFIG_REBOOT=y
```

## drivers/Kconfig
```kconfig
# Copyright (c) 2025 .
# SPDX-License-Identifier: Apache-2.0

menu "Drivers"
rsource "serial/Kconfig"
endmenu
```

## drivers/serial/Kconfig.uniphier
```kconfig
# SPDX-License-Identifier: Apache-2.0

menuconfig UART_UNIPHIER
	bool "UniPhier serial driver"
	default y
	depends on DT_HAS_SOCIONEXT_UNIPHIER_UART_ENABLED
	select SERIAL_HAS_DRIVER
	select SERIAL_SUPPORT_INTERRUPT
	help
	  This option enables the UniPhier serial driver.
	  This driver can be used for the serial hardware
	  available on UniPhier boards.

if UART_UNIPHIER

config UART_UNIPHIER_LINE_CTRL
	bool "Serial line control for apps"
	depends on UART_LINE_CTRL
	help
	  This enables the API for apps to control the serial line,
	  such as CTS and RTS.

	  Says n if not sure.

endif
```

## dts/bindings/serial/socionext,uniphier-uart.yaml
```yaml
# SPDX-License-Identifier: Apache-2.0
# Copyright (c) 2025 Socionext Inc.

description: Socionet UniPhier UART

compatible: "socionext,uniphier-uart"

include: uart-controller.yaml

properties:
  reg:
    required: true
```

## soc/socionext/uniphier/ld20/Kconfig
```kconfig
# SPDX-License-Identifier: Apache-2.0
# Copyright (c) 2025 Socionext Inc.

config SOC_UNIPHIER_LD20
	select ARM64
	select CPU_CORTEX_A72
	select ARM_ARCH_TIMER if SYS_CLOCK_EXISTS
```

## soc/socionext/uniphier/ld20/Kconfig.defconfig
```kconfig
# SPDX-License-Identifier: Apache-2.0
# Copyright (c) 2025 Socionext Inc.

if SOC_UNIPHIER_LD20

config NUM_IRQS
	default 288

config SYS_CLOCK_HW_CYCLES_PER_SEC
	default 50000000

endif # SOC_UNIPHIER_LD20
```

## soc/socionext/uniphier/ld20/Kconfig.soc
```kconfig
# SPDX-License-Identifier: Apache-2.0
# Copyright (c) 2025 Socionext Inc.

config SOC_UNIPHIER_LD20
	bool

config SOC
	default "ld20" if SOC_UNIPHIER_LD20
```

## soc/socionext/uniphier/nx1/Kconfig
```kconfig
# SPDX-License-Identifier: Apache-2.0
# Copyright (c) 2025 Socionext Inc.

config SOC_UNIPHIER_NX1
	select ARM64
	select CPU_CORTEX_A53
	select ARM_ARCH_TIMER if SYS_CLOCK_EXISTS
```

## soc/socionext/uniphier/nx1/Kconfig.soc
```kconfig
# SPDX-License-Identifier: Apache-2.0
# Copyright (c) 2025 Socionext Inc.

config SOC_UNIPHIER_NX1
	bool

config SOC
	default "nx1"  if SOC_UNIPHIER_NX1
```

## west.yml
```yaml
# Copyright (c) 2025 .
# SPDX-License-Identifier: Apache-2.0

manifest:
  remotes:
    - name: zephyrproject-rtos
      url-base: https://github.com/zephyrproject-rtos

  projects:
    - name: zephyr
      remote: zephyrproject-rtos
      revision: main
      west-commands: scripts/west-commands.yml
```
